## Kconfig
```kconfig
mainmenu "Toolen settings"

menuconfig BASIC_CMDS
	bool "Basic Commands"
	default y
	if BASIC_CMDS
		source generated/basic.conf
	endif

menuconfig FILE_CMDS
	bool "File operations"
	default y
	if FILE_CMDS
		source generated/file.conf
	endif

menuconfig SYS_CMDS
	bool "System operations"
	default y
	if SYS_CMDS
		source generated/sys.conf
	endif

menuconfig STR_CMDS
	bool "String operations"
	default y
	if STR_CMDS
		source generated/string.conf
	endif

menuconfig OTHER_CMDS
	bool "Other commands"
	default y
	if OTHER_CMDS
		source generated/others.conf
	endif

menuconfig DEVEL_CMDS
	bool "In Development"
	default n
	if DEVEL_CMDS
		source generated/devel.conf
	endif

# Cut line
comment "Global settings"

menu "System configurations"
	config DEF_HAVE_URANDOM
		bool "/dev/urandom device support"
		default y
		help
			/dev/urandom device support
	config DEF_HAVE_PASSWD
		bool "/etc/passwd file support"
		default y
		help
			/etc/passwd file support
	config DEF_HAVE_GROUP
		bool "/etc/group file support"
		default y
		help
			/etc/passwd file support

	config DEF_ANDROID_NSS
		bool "Android user name support"
		default n
		help
			User name would be like 'u0_aXXXX'

endmenu

menu "Build options"
	config VERSION_APPEND
		string "Local version - append to Toolen release"
		default ""
		help
			Set local version that append to Toolen release
	config HOST_C_CPLR
		string "Host C Compiler"
		default "gcc"
		help
			Set host C compiler
	config C_CPLR
		string "C Compiler"
		default "gcc"
		help
			Set default C compiler

	config WALL
		bool "Enable all warnings"
		default n
		help
			Compile with -Wall

	config WERROR
		bool "Treat warnings as errors (-Werror)"
		depends WALL
		default n
		help
			Treat warnings as errors, compile with -Werror

	config NOWCPP
		bool "Disable #warning support"
		default n
		help
			Disable support for #warning

	config DEF_STATIC_LINK
		bool "Static link"
		default n
		help
			Static link
			TIPS: It will cause some warnings, so we don't recommend you enable this option
	config STRIP
		bool "Strip symbols"
		default n
		help
			Strip symbols in final executable

	if !DEF_STATIC_LINK
	config DEF_LIBNSS
		bool "libnss support"
		default y
		help
			Enable Name Service Switch(NSS) support
	endif

	# MIT LICENSE
	config COMPILE_LICENSE
		bool "Compile LICENSE"
		default y
		help
			Compile MIT LICENSE in main/main.c

	# Debug options
	comment 'Debug options'

	config DEBUG_SPT
		bool "Debug support"
		default y
		help
			Compile with '-g'

	config DEBUG_OUTPUT
		bool "Print log output"
		depends DEBUG_SPT
		default n
		help
			Print log to stderr

	config MEMLEAK_CHECK
		bool "Check memory leak"
		default n
		help
			Compile with '-fsanitize=address' and link library asan
endmenu
```
